## samples/random_exps/Kconfig
```kconfig
# Private config options for can sample app

# Copyright (c) 2020 Peter Kietzmann
# SPDX-License-Identifier: Apache-2.0

mainmenu "PRNG measurement application"

choice
	prompt "PRNG choice"
	default XORSHIFT

config XORSHIFT
	bool "xorshift 32 generator"

config MINSTD
	bool "minimal standard"

config MUSLLCG
	bool "knuth LCG"

config TINYMT32
	bool "tiny mersenne twister"

config MERSENNE
	bool "mersenne twister"

config SHA256PRNG
	bool "sha256 prng"

config TRNG
	bool "hardware TRNG"
	select ENTROPY_GENERATOR

endchoice

source "Kconfig.zephyr"
```
