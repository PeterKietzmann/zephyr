## CMakeLists.txt
```
# SPDX-License-Identifier: Apache-2.0

cmake_minimum_required(VERSION 3.13.1)

include($ENV{ZEPHYR_BASE}/cmake/app/boilerplate.cmake NO_POLICY_SCOPE)
project(prng_minstd)

target_sources(app PRIVATE src/main.c)
```

## prj.conf
```kconfig
# nothing here
CONFIG_STDOUT_CONSOLE=y
CONFIG_BOOT_BANNER=n
CONFIG_BOOT_DELAY=0
```

## src/main.c
```c
/*
 * Copyright (c) 2012-2014 Wind River Systems, Inc.
 *
 * SPDX-License-Identifier: Apache-2.0
 */

#include <zephyr.h>
#include "stdio.h"

// seed used in RIOT experiments
static uint32_t _state32 = 534571505;


#define a 48271
#define m 2147483647
#define q (m / a) /* 44488 */
#define r (m % a) /* 3399 */



static inline uint32_t div_u32_by_44488(uint32_t val)
{
    return ((uint64_t)val * 0xBC8F1391UL) >> (15 + 32);
}

static inline uint32_t div_u32_mod_44488(uint32_t val)
{
    return val - (div_u32_by_44488(val)*44488);
}

int rand_minstd(void)
{
    uint32_t hi = div_u32_by_44488(_state32);
    uint32_t lo = div_u32_mod_44488(_state32);
    int32_t test = (a * lo) - (r * hi);

    if(test > 0) {
        _state32 = test;
    }
    else {
        _state32 = test + m;
    }

    return _state32;
}

uint32_t random_uint32(void)
{
    /* minstd as implemented returns only values from 1 to 2147483647,
     * so run it two times to get 32bits */
    uint16_t A = (rand_minstd() >> 15);
    uint16_t B = (rand_minstd() >> 15);
    return  (((uint32_t)A) << 16) | B;
}


void main(void)
{
	printf("prng_minstd\n");
	int i=0;
	while(i<10) {
		printf("0x%x\n", random_uint32());
		i++;
	}
}
	
```
