## CMakeLists.txt
```
# SPDX-License-Identifier: Apache-2.0

cmake_minimum_required(VERSION 3.13.1)

include($ENV{ZEPHYR_BASE}/cmake/app/boilerplate.cmake NO_POLICY_SCOPE)
project(prng_xorshift)

target_sources(app PRIVATE src/main.c)
```

## prj.conf
```kconfig
# nothing here
CONFIG_GPIO=y
CONFIG_STDOUT_CONSOLE=y
CONFIG_BOOT_BANNER=n
CONFIG_BOOT_DELAY=0
```

## src/main.c
```c
/*
 * Copyright (c) 2020 HAW Hamburg
 *
 * SPDX-License-Identifier: Apache-2.0
 */

#include <stdio.h>
#include <zephyr.h>
#include <device.h>
#include <drivers/gpio.h>
#include <drivers/pinmux.h>
#include <fsl_port.h>

#if CONFIG_XORSHIFT
#include "xorshift.c"
#elif CONFIG_MINSTD
#include "minstd.c"
#elif CONFIG_MUSLLCG
#include "musllcg.c" 
#elif CONFIG_TINYMT32
#include "tinymt32.c"
#elif CONFIG_MERSENNE
#include "mersenne.c" 
#endif

#define GPIO_PORT DT_LABEL(DT_NODELABEL(gpiob))
#define GPIO_PORT_MUX DT_LABEL(DT_NODELABEL(portb))
#define GPIO_PIN 29

#define EXP_DURATION 10 // seconds

#define NUM_MEAS 100

uint32_t seed = 534571505;

struct device *dev;
unsigned running;
unsigned rand_integers=0;

void my_timer_handler(struct k_timer *);
K_TIMER_DEFINE(my_timer, my_timer_handler, NULL);

static inline void init_gpio(void)
{
	pinmux_pin_set(device_get_binding(GPIO_PORT_MUX), GPIO_PIN, PORT_PCR_MUX(kPORT_MuxAsGpio));
	dev = device_get_binding(GPIO_PORT);

	if (dev == NULL) {
		printf("device_get_binding FAILED\n");
		return;
	}

	int ret = gpio_pin_configure(dev, GPIO_PIN, GPIO_OUTPUT);
	if (ret < 0) {
		printf("gpio_pin_configure FAILED\n");
		return;
	}
}

void my_timer_handler(struct k_timer *dummy)
{
	running = 0;
	// k_timer_stop(&my_timer);
	// printf("rand_integers: %i in %i seconds\n", rand_integers, EXP_DURATION);
	// rand_integers=0;
	// if(num_meas < NUM_MEAS) {
	// 	k_timer_start(&my_timer, K_SECONDS(EXP_DURATION), K_SECONDS(1));
	// }
}

void main(void)
{
	printf("RNG\n");
	random_init(seed);

	// bool led_is_on = true;
	init_gpio();
	
	printf("EXP_DURATION [s]: %i\n", EXP_DURATION);
	for (int i = 0; i < NUM_MEAS; i++)
	{
		rand_integers = 0;
		running = 1;
		k_timer_start(&my_timer, K_SECONDS(EXP_DURATION), K_SECONDS(1));
		while(running) {
			// gpio_pin_set(dev, GPIO_PIN, (int)led_is_on);	
			// led_is_on = !led_is_on;
			// printf("0x%x\n", random_uint32());
			random_uint32();
			rand_integers++;
		}
		k_timer_stop(&my_timer);
		printf("%3i/%i: rand_integers: %i\n", i, NUM_MEAS, rand_integers);
	}
}
	
```

## src/minstd.c
```c
#define a 48271
#define m 2147483647
#define q (m / a) /* 44488 */
#define r (m % a) /* 3399 */

static uint32_t _state32;// = 534571505;


static inline uint32_t div_u32_by_44488(uint32_t val)
{
    return ((uint64_t)val * 0xBC8F1391UL) >> (15 + 32);
}

static inline uint32_t div_u32_mod_44488(uint32_t val)
{
    return val - (div_u32_by_44488(val)*44488);
}

int rand_minstd(void)
{
    uint32_t hi = div_u32_by_44488(_state32);
    uint32_t lo = div_u32_mod_44488(_state32);
    int32_t test = (a * lo) - (r * hi);

    if(test > 0) {
        _state32 = test;
    }
    else {
        _state32 = test + m;
    }

    return _state32;
}

uint32_t random_uint32(void)
{
    /* minstd as implemented returns only values from 1 to 2147483647,
     * so run it two times to get 32bits */
    uint16_t A = (rand_minstd() >> 15);
    uint16_t B = (rand_minstd() >> 15);
    return  (((uint32_t)A) << 16) | B;
}

void random_init(uint32_t seed)
{
    printf("MINSTD\n");
    _state32 = seed;
}
```

## src/musllcg.c
```c
static uint64_t _state64;

uint32_t musl_lcg(void)
{
    _state64 = 6364136223846793005ULL*_state64 + 1;
    return _state64>>32;
}

uint32_t random_uint32(void)
{
    return musl_lcg();
}

void random_init(uint32_t s)
{
    printf("Musl LCG\n");
    _state64 = s-1;
}
```

## src/tinymt32.c
```c
#include <stdint.h>
#include <stddef.h>
#include <inttypes.h>

#define UINT32_C(x)  ((x) + (UINT32_MAX - UINT32_MAX))


typedef struct TINYMT32_T tinymt32_t;

#define TINYMT32_MEXP 127
#define TINYMT32_SH0 1
#define TINYMT32_SH1 10
#define TINYMT32_SH8 8
#define TINYMT32_MASK UINT32_C(0x7fffffff)
#define TINYMT32_MUL (1.0f / 16777216.0f)


/**
 * tinymt32 internal state vector and parameters
 */
struct TINYMT32_T {
    uint32_t status[4];
    uint32_t mat1;
    uint32_t mat2;
    uint32_t tmat;
};

static tinymt32_t _random;


/**
 * This function changes internal state of tinymt32.
 * Users should not call this function directly.
 * @param random tinymt internal status
 */
static inline void tinymt32_next_state(tinymt32_t *random)
{
    uint32_t x;
    uint32_t y;

    y = random->status[3];
    x = (random->status[0] & TINYMT32_MASK)
        ^ random->status[1]
        ^ random->status[2];
    x ^= (x << TINYMT32_SH0);
    y ^= (y >> TINYMT32_SH0) ^ x;
    random->status[0] = random->status[1];
    random->status[1] = random->status[2];
    random->status[2] = x ^ (y << TINYMT32_SH1);
    random->status[3] = y;
    random->status[1] ^= -((int32_t)(y & 1)) & random->mat1;
    random->status[2] ^= -((int32_t)(y & 1)) & random->mat2;
}

/**
 * This function outputs 32-bit unsigned integer from internal state.
 * Users should not call this function directly.
 * @param random tinymt internal status
 * @return 32-bit unsigned pseudorandom number
 */
static inline uint32_t tinymt32_temper(tinymt32_t *random)
{
    uint32_t t0, t1;

    t0 = random->status[3];
    t1 = random->status[0] + (random->status[2] >> TINYMT32_SH8);
    t0 ^= t1;
    t0 ^= -((int32_t)(t1 & 1)) & random->tmat;
    return t0;
}


/**
 * This function outputs 32-bit unsigned integer from internal state.
 * @param random tinymt internal status
 * @return 32-bit unsigned integer r (0 <= r < 2^32)
 */
static inline uint32_t tinymt32_generate_uint32(tinymt32_t *random)
{
    tinymt32_next_state(random);
    return tinymt32_temper(random);
}



#define MIN_LOOP 8
#define PRE_LOOP 8


/**
 * This function certificate the period of 2^127-1.
 * @param random tinymt state vector.
 */
static void period_certification(tinymt32_t *random)
{
    if ((random->status[0] & TINYMT32_MASK) == 0 &&
        random->status[1] == 0 &&
        random->status[2] == 0 &&
        random->status[3] == 0) {
        random->status[0] = 'T';
        random->status[1] = 'I';
        random->status[2] = 'N';
        random->status[3] = 'Y';
    }
}

/**
 * This function initializes the internal state array with a 32-bit
 * unsigned integer seed.
 * @param random tinymt state vector.
 * @param seed a 32-bit unsigned integer used as a seed.
 */
void tinymt32_init(tinymt32_t *random, uint32_t seed)
{
    random->status[0] = seed;
    random->status[1] = random->mat1;
    random->status[2] = random->mat2;
    random->status[3] = random->tmat;
    for (int i = 1; i < MIN_LOOP; i++) {
        random->status[i & 3] ^= i + UINT32_C(1812433253)
                                 * (random->status[(i - 1) & 3]
                                    ^ (random->status[(i - 1) & 3] >> 30));
    }
    period_certification(random);
    for (int i = 0; i < PRE_LOOP; i++) {
        tinymt32_next_state(random);
    }
}


void random_init(uint32_t seed)
{
    printf("TinyMT32\n");
    tinymt32_init(&_random, seed);
}

uint32_t random_uint32(void)
{
    return tinymt32_generate_uint32(&_random);
}
```
